/* Slow down scroll from the split pointing device (multiplier/divisor = 1/3). */
&pointing_device_split_listener {
    input-processors = <&zip_xy_transform (INPUT_TRANSFORM_X_INVERT | INPUT_TRANSFORM_Y_INVERT)>,
                       <&zip_scroll_scaler 1 3>;
};
