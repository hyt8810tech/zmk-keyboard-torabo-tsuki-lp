/* Speed up the cursor by 5/4, and activate layer 1 for 500ms while the central pointing device moves. */
&pointing_listener {
    input-processors = <&zip_xy_transform (INPUT_TRANSFORM_X_INVERT | INPUT_TRANSFORM_Y_INVERT)>,
                       <&zip_xy_scaler 5 4>,
                       <&zip_temp_layer 1 500>;
};

/* Key position 37 on S Layout (left thumb, LSHIFT/LANG1 on layer 0) is used as click on layer 1. */
&zip_temp_layer {
    excluded-positions = <37>;
};
